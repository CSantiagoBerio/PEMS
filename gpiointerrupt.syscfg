// These arguments were used when this file was generated. They will be automatically applied on subsequent loads 
// via the GUI or CLI invocations. Run CLI with '--help' for additional information on how to override these arguments.
// @cliArgs --board "/ti/boards/CC3220S_LAUNCHXL" --product "SimpleLinkSDK@3.30.00.04"
// @versions {"data":"2019083011","timestamp":"2019083011","tool":"1.2.952","templates":"2019083011"}

var RTOS = scripting.addModule("/ti/drivers/RTOS");
var GPIO = scripting.addModule("/ti/drivers/GPIO");
var Power = scripting.addModule("/ti/drivers/Power");
var Board = scripting.addModule("/ti/drivers/Board");
var DriverLib = scripting.addModule("/ti/devices/DriverLib");
var GPIO1 = GPIO.addInstance();
var UART = scripting.addModule("/ti/drivers/UART");
var UART1 = UART.addInstance();
var UART2 = UART.addInstance();
var Capture = scripting.addModule("/ti/drivers/Capture");
var Capture1 = Capture.addInstance();
var Timer = scripting.addModule("/ti/drivers/Timer");
var Timer1 = Timer.addInstance();
// Keep Debug Active During LPDS - Keep debug interface active during Low-Power Deep Sleep (LPDS)
Power.keepDebugActiveDuringLPDS = true;
// Name
Power.parkPins.$name = "ti_drivers_power_PowerCC32XXPins0";
// Name - The C/C++ identifier used in applications as the index parameter passed to GPIO runtime APIs
GPIO1.$name = "TEMP";
// Mode - Select the GPIO mode
GPIO1.mode = "Dynamic";
// Assign pin
GPIO1.gpioPin.$assign = "boosterpack.7"; // P05
// Name - The C/C++ identifier used in applications as the index parameter passed to UART runtime APIs
UART1.$name = "UART_LOCAL";
// Use Hardware - Select the hardware to use, or 'None' to use available header pins
UART1.$hardware = system.deviceData.board.components.XDS110UART;
// Name
UART1.uart.$name = "MyUART1";
// Name - The C/C++ identifier used in applications as the index parameter passed to UART runtime APIs
UART2.$name = "UART_CO2";
// Ring Buffer Size - Number of bytes in the ring buffer
UART2.ringBufferSize = 9;
// Name
UART2.uart.$name = "MyUART1";
// Assign pin
UART2.uart.txPin.$assign = "boosterpack.15"; // P07
// Assign pin
UART2.uart.rxPin.$assign = "boosterpack.18"; // P08
// Name - The C/C++ identifier used in applications as the index parameter passed to Capture runtime APIs
Capture1.$name = "TEMP_CAPTURE";
// Name
Capture1.timer.$name = "MyTimer1";
// Assign pin
Capture1.timer.capturePin.$assign = "boosterpack.4"; // P03
// Name - The C/C++ identifier used in applications as the index parameter passed to Timer runtime APIs
Timer1.$name = "CONFIG_TIMER_0";
// Name
Timer1.timer.$name = "MyTimer1";
// Suggest solution
UART1.uart.$suggestSolution = "UART0";
// Suggest solution
UART1.uart.txPin.$suggestSolution = "55";
// Suggest solution
UART1.uart.rxPin.$suggestSolution = "57";
// Suggest solution
UART2.uart.$suggestSolution = "UART1";
// Suggest solution
Capture1.timer.$suggestSolution = "Timer1";
// Suggest solution
Timer1.timer.$suggestSolution = "Timer0";
